## arch/tct/Kconfig.cpu
```kconfig
menu "Processors, Board and Features"

choice
	prompt "TCT platform"
	default PLAT_TCT

config PLAT_TCT
	bool "tct"
	help
	  TCT Platform

endchoice

if (PLAT_TCT)
choice
	prompt "CPU"
	default CPU_TCT

config CPU_TCT
	bool "tct"
	help
	  TCT processor.
endchoice

choice
	prompt "Board Selection"
	default TCT_BOARD

config	TCT_BOARD
	bool "TCT Board"

endchoice
endif

config CPU_CLOCK
	int "CPU Clock [Hz] (integer)"
	default "80000000" if TCT_BOARD

config KERNEL_RAM_BASE_ADDRESS
	hex "Physical memory start address (hex)"
	default "0x00000000"

config KERNEL_BASE_ADDR
	hex "Physical address where Linux Kernel is"
	default "0x00000000"
	help
	  Define where the kernel will be loaded to and executed from.

config EARLY_PRINTK
	bool "Early printk"
	default y
	help
	  This option enables special console drivers which allow the kernel
	  to print messages very early in the bootup process.

	  This is useful for kernel debugging when your machine crashes very
	  early before the console code is initialized. You should normally
	        say N here, unless you want to debug.

config TCT_HW_JTAG
bool "Disable kernel exception handling (enable JTAG debugging)"
	default n
	help
	  This option disables the exception handling within the kernel. It is
	  required to allow access with the JTAG debugger for kernel-level
	  debug access.

	  Your should normally say N here, unless you want to debug.
endmenu
```
